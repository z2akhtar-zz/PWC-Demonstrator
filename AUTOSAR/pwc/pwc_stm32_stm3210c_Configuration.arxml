AUTOSAR XML (schema 4-0-3)
package /OsSimple_stm32_mcbstm32
  ecuc value collection PWCEcu: ecu-extract=PWCSystem, ecuc-values=[EcuM, Mcu, Det, Os, Dio, Port, EcuC, IoHwAb, Rte, Com, PduR]
  module config Det: implementation-config-variant=VARIANT-PRE-COMPILE, module-description=Det
    DetGeneral: DetVersionInfoApi=0, DetUseRamlog=1, DetEnableCallbacks=0, DetWrapRamlog=1, DetUseStdErr=0, DetDeInitAPI=0, DetNumberOfCallbacks=5, DetRamlogSize=16
  module config Os: implementation-config-variant=VARIANT-PRE-COMPILE, module-description=Os
    OsAppMode
    OsOS:
      OsScalabilityClass = SC1
      OsStackMonitoring = 1
      OsStatus = EXTENDED
      OsUseGetServiceId = 1
      OsUseParameterAccess = 1
      OsUseResScheduler = 1
      ArcOsTickFrequency = 1000
      ArcOsInterruptStackSize = 2048
      ArcOsIdleStackSize = 512
      ArcOsMaxIsr = 10
      OsHooks: OsErrorHook=1, OsPostTaskHook=0, OsPreTaskHook=0, OsShutdownHook=1, OsStartupHook=1
      ArcOsDebug: OsTaskDebug=1, OsAlarmDebug=1, OsResourceDebug=0, OsScheduleTableDebug=0, OsEventDebug=1, OsDebugActivated=1
    Alarm_Main (OsAlarm): OsAlarmCounterRef=OsCounter, OsAlarmAccessingApplication=OsApplication
      OsAlarmAction
        OsAlarmSetEvent: OsAlarmSetEventRef=OsEvent_Main, OsAlarmSetEventTaskRef=OsTask_Main
      OsAlarmAutostart: OsAlarmAlarmTime=10, OsAlarmAutostartType=RELATIVE, OsAlarmCycleTime=0, OsAlarmAppModeRef=(unset)
    OsTask_Main (OsTask): OsTaskActivation=1, OsTaskPriority=1, OsTaskSchedule=FULL, ArcOsTaskStackSize=2048, OsTaskEventRef=OsEvent_Main
      OsTaskAutostart: OsTaskAppModeRef=(unset)
    OsEvent_Main (OsEvent)
    OsCounter:
      OsCounterMaxAllowedValue = 65535
      OsCounterMinCycle = 1
      OsCounterTicksPerBase = (unset)
      OsCounterType = OS_TICK
      OsCounterAccessingApplication = OsApplication
    OsApplication:
      OsTrusted = 1
      OsAppAlarmRef = Alarm_Main
      OsAppCounterRef = OsCounter
      OsAppTaskRef = OsTask_Main
      OsAppTaskRef = StepTask
      OsAppAlarmRef = StepAlarm
      OsAppAlarmRef = CriticalAlarm
      OsAppTaskRef = CriticalTask
      OsApplicationHooks: OsAppErrorHook=0, OsAppShutdownHook=0, OsAppStartupHook=0
    StepAlarm (OsAlarm): OsAlarmCounterRef=OsCounter, OsAlarmAccessingApplication=OsApplication
      OsAlarmAction
        OsAlarmSetEvent: OsAlarmSetEventRef=StepEvent, OsAlarmSetEventTaskRef=StepTask
      OsAlarmAutostart: OsAlarmAlarmTime=100, OsAlarmAutostartType=ABSOLUTE, OsAlarmCycleTime=100, OsAlarmAppModeRef=(unset)
    StepEvent (OsEvent)
    StepTask (OsTask): OsTaskActivation=1, OsTaskPriority=3, OsTaskSchedule=FULL, ArcOsTaskStackSize=2048, OsTaskEventRef=StepEvent
      OsTaskAutostart: OsTaskAppModeRef=(unset)
    CriticalEvent (OsEvent)
    CriticalTask (OsTask): OsTaskActivation=1, OsTaskPriority=5, OsTaskSchedule=FULL, ArcOsTaskStackSize=2048, OsTaskEventRef=CriticalEvent
      OsTaskAutostart: OsTaskAppModeRef=(unset)
    CriticalAlarm (OsAlarm): OsAlarmCounterRef=OsCounter, OsAlarmAccessingApplication=OsApplication
      OsAlarmAction
        OsAlarmSetEvent: OsAlarmSetEventRef=CriticalEvent, OsAlarmSetEventTaskRef=CriticalTask
      OsAlarmAutostart: OsAlarmAlarmTime=50, OsAlarmAutostartType=ABSOLUTE, OsAlarmCycleTime=50, OsAlarmAppModeRef=(unset)
  module config Dio: implementation-config-variant=VARIANT-PRE-COMPILE, module-description=Dio
    DioConfig
      4 x DioPort:
        LED_PORT: DioPortId=3
          4 x DioChannel:
            LED_1: DioChannelId=55
            LED_4: DioChannelId=52
            LED_3: DioChannelId=51
            LED_2: DioChannelId=61
        PortA: DioPortId=0
          WakeUp (DioChannel): DioChannelId=0
        PortB: DioPortId=1
          3 x DioChannel:
            Key: DioChannelId=25
            I2C_SDA: DioChannelId=22
            I2C_SCL: DioChannelId=21
        PortC: DioPortId=2
          Tamper (DioChannel): DioChannelId=45
    DioGeneral: DioDevErrorDetect=1, DioFlipChannelApi=(unset), DioVersionInfoApi=1
  module config Port: implementation-config-variant=VARIANT-PRE-COMPILE, module-description=Port
    PortConfigSet
      4 x PortContainer, all with PortNumberOfPortPins=(unset):
        LED
          4 x PortPin, all with PortPinDirection=PORT_PIN_OUT, PortPinDirectionChangeable=(unset), PortPinInitialMode=, PortPinLevelValue=PORT_PIN_LEVEL_LOW, PortPinMode=, PortPinModeChangeable=(unset), ArcPortPinGpioMode=GPIO_OUTPUT_PUSHPULL_CNF, ArcPortPinSlewRate=PORT_PIN_SLEW_RATE_MED:
            PD7: PortPinId=55
            PD13: PortPinId=61
            PD3: PortPinId=51
            PD4: PortPinId=52
        PortB
          3 x PortPin, all with PortPinDirectionChangeable=(unset), PortPinInitialMode=, PortPinLevelValue=PORT_PIN_LEVEL_LOW, PortPinMode=, PortPinModeChangeable=(unset):
            Key: PortPinDirection=PORT_PIN_IN, PortPinId=25, ArcPortPinGpioMode=GPIO_FLOATING_INPUT_CNF, ArcPortPinSlewRate=PORT_PIN_SLEW_RATE_MIN
            I2C_SCL: PortPinDirection=PORT_PIN_OUT, PortPinId=21, ArcPortPinGpioMode=GPIO_ALT_OPENDRAIN_CNF, ArcPortPinSlewRate=PORT_PIN_SLEW_RATE_MED
            I2C_SDA: PortPinDirection=PORT_PIN_OUT, PortPinId=22, ArcPortPinGpioMode=GPIO_ALT_OPENDRAIN_CNF, ArcPortPinSlewRate=PORT_PIN_SLEW_RATE_MED
        PortA
          WakeUp (PortPin):
            PortPinDirection = PORT_PIN_IN
            PortPinDirectionChangeable = (unset)
            PortPinId = 0
            PortPinInitialMode = 
            PortPinLevelValue = PORT_PIN_LEVEL_LOW
            PortPinMode = 
            PortPinModeChangeable = (unset)
            ArcPortPinGpioMode = GPIO_FLOATING_INPUT_CNF
            ArcPortPinSlewRate = PORT_PIN_SLEW_RATE_MED
        PortC
          Tamper (PortPin):
            PortPinDirection = PORT_PIN_IN
            PortPinDirectionChangeable = (unset)
            PortPinId = 45
            PortPinInitialMode = 
            PortPinLevelValue = PORT_PIN_LEVEL_LOW
            PortPinMode = 
            PortPinModeChangeable = (unset)
            ArcPortPinGpioMode = GPIO_FLOATING_INPUT_CNF
            ArcPortPinSlewRate = PORT_PIN_SLEW_RATE_MIN
    PortGeneral: PortDevErrorDetect=1, PortSetPinDirectionApi=1, PortSetPinModeApi=0, PortVersionInfoApi=1
  module config EcuC: implementation-config-variant=VARIANT-PRE-COMPILE, module-description=EcuC
    EcucPduCollection: PduIdTypeEnum=UINT16, PduLengthTypeEnum=UINT16
  module config IoHwAb: implementation-config-variant=VARIANT-PRE-COMPILE, module-description=IoHwAb
    ArcIoHwAbGeneral: ArcIoHwAbDevErrorDetect=1, ArcIoHwAbAnalogMaxVoltage=5.0, ArcIoHwAbUsePort=0, ArcIoHwCalibrationEnabled=0
    4 x ArcIoHwAbDigitalSignal, all with ArcIoHwAbDigitalInverted=0, ArcIoHwAbDigitalType=IOHWAB_DIO:
      MOTOR_1: ArcIoHwAbDigitalDefaultValue=IOHWAB_LOW, ArcIoHwAbDigitalMethod=IOHWAB_DIGITAL_WRITE, ArcIoHwAbDioChannelRef=LED_1
      EndStop: ArcIoHwAbDigitalDefaultValue=IOHWAB_HIGH, ArcIoHwAbDigitalMethod=IOHWAB_DIGITAL_READ, ArcIoHwAbDioChannelRef=PortB/Key
      Obstacle: ArcIoHwAbDigitalDefaultValue=IOHWAB_HIGH, ArcIoHwAbDigitalMethod=IOHWAB_DIGITAL_READ, ArcIoHwAbDioChannelRef=PortC/Tamper
      MOTOR_2: ArcIoHwAbDigitalDefaultValue=IOHWAB_LOW, ArcIoHwAbDigitalMethod=IOHWAB_DIGITAL_WRITE, ArcIoHwAbDioChannelRef=LED_2
  module config Rte: implementation-config-variant=VARIANT-PRE-COMPILE, module-description=Rte
    RteBswGeneral: RteSchMVersionInfoApi=(unset), RteUseComShadowSignalApi=0
    RteGeneration:
      RteCalibrationSupport = NONE
      RteCodeVendorId = (unset)
      RteDevErrorDetect = 0
      RteDevErrorDetectUninit = 0
      RteGenerationMode = COMPATIBILITY_MODE
      RteIocInteractionReturnValue = RTE_IOC
      RteMeasurementSupport = 0
      RteOptimizationMode = RUNTIME
      RteValueRangeCheckEnabled = 0
      RteVfbTraceEnabled = 0
    RteInitializationBehavior: RteInitializationStrategy=, RteSectionInitializationPolicy=
    RteOsInteraction
    RtePostBuildVariantConfiguration: RtePostBuildUsedPredefinedVariant=(unset)
    7 x RteSwComponentInstance:
      EndStopDtc: RteSoftwareComponentInstanceRef=EndStopDtc
        StepEndStop_StepTask (RteEventToTaskMapping): RteImmediateRestart=0, RtePositionInTask=2, RteEventRef=StepEndStop, RteMappedToTaskRef=CriticalTask, RteUsedOsEventRef=CriticalEvent
      ioHwAb: RteSoftwareComponentInstanceRef=ioHwAb
      MotorDriver: RteSoftwareComponentInstanceRef=MotorDriver
        StepMotor_StepTask (RteEventToTaskMapping): RteImmediateRestart=0, RtePositionInTask=3, RteEventRef=StepMotor, RteMappedToTaskRef=StepTask, RteUsedOsEventRef=StepEvent
      ObstacleDtc: RteSoftwareComponentInstanceRef=ObstacleDtc
        StepObstacle_StepTask (RteEventToTaskMapping): RteImmediateRestart=0, RtePositionInTask=1, RteEventRef=StepObstacle, RteMappedToTaskRef=CriticalTask, RteUsedOsEventRef=CriticalEvent
      Switch: RteSoftwareComponentInstanceRef=Switch
        SwitchEvent_StepTask (RteEventToTaskMapping): RteImmediateRestart=0, RtePositionInTask=1, RteEventRef=SwitchEvent, RteMappedToTaskRef=StepTask, RteUsedOsEventRef=StepEvent
      WinArbitrator: RteSoftwareComponentInstanceRef=WinArbitrator
        StepArbitrator_StepTask (RteEventToTaskMapping): RteImmediateRestart=0, RtePositionInTask=2, RteEventRef=StepArbitrator, RteMappedToTaskRef=StepTask, RteUsedOsEventRef=StepEvent
      WinController: RteSoftwareComponentInstanceRef=WinController
        StepController_StepTask (RteEventToTaskMapping): RteImmediateRestart=0, RtePositionInTask=3, RteEventRef=StepController, RteMappedToTaskRef=CriticalTask, RteUsedOsEventRef=CriticalEvent
  module config Com: implementation-config-variant=VARIANT-POST-BUILD, module-description=Com
    ComConfig: ComConfigurationId=(unset)
      ComTimeBase
    ComGeneral:
      ComSupportedIPduGroups = 0
      ComVersionInfoApi = 0
      ComSupportedIPdus = 0
      ComSupportedSignals = 0
      ComSupportedGroupSignals = 0
      ComRamBufferSize = 512
      ArcMaxNumberOfSupportedIPduCounters = 10
      ComConfigurationUseDet = 0
  module config PduR: implementation-config-variant=VARIANT-POST-BUILD, module-description=PduR
    PduRGeneral: PduRDevErrorDetect=1, PduRVersionInfoApi=0, PduRZeroCostOperation=0
    PduRRoutingTables: PduRConfigurationId=0, ArcPduRMaxRouteCount=0
    Com (PduRBswModules):
      PduRCancelReceive = 0
      PduRCancelTransmit = (unset)
      PduRChangeParameterRequestApi = (unset)
      PduRCommunicationInterface = (unset)
      PduRLowerModule = 0
      PduRRetransmission = (unset)
      PduRTransportProtocol = (unset)
      PduRTriggertransmit = (unset)
      PduRTxConfirmation = (unset)
      PduRUpperModule = 1
      PduRUseTag = (unset)
      PduRBswModuleRef = (unset)
