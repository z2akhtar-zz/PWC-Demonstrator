AUTOSAR XML (schema 4-1-1)
package /ArcCore/Services/IoHwAb
  impl type IoHwAb_SignalType_: implementation-data-type=uint32
  app type dummy_IoHwAb_SignalType_: category=VALUE
  data type mapping set dummyMappingSet: data-type-map{application-data-type=dummy_IoHwAb_SignalType_, implementation-data-type=IoHwAb_SignalType_}
  impl type SignalQuality: compu {0=IOHWAB_INIVAL, 1=IOHWAB_ERR, 2=IOHWAB_BAD, 3=IOHWAB_GOOD}, implementation-data-type=uint8
  impl type DigitalLevel: compu {0=IOHWAB_LOW, 1=IOHWAB_HIGH}, implementation-data-type=uint8
  impl type AnalogValue: implementation-data-type=sint32
  impl type DutyCycle: implementation-data-type=uint32
  impl type Frequency: implementation-data-type=uint32
  6 x client server interface, all with is-service=true:
    DigitalServiceRead
      operation Read: possible-error=[DigitalServiceRead/E_OK, DigitalServiceRead/E_NOT_OK]
        arg Level: type=DigitalLevel, direction=OUT
        arg Quality: type=SignalQuality, direction=OUT
      error E_OK: error-code=0
      error E_NOT_OK: error-code=1
    DigitalServiceWrite
      operation Write: possible-error=[DigitalServiceWrite/E_OK, DigitalServiceWrite/E_NOT_OK]
        arg Level: type=DigitalLevel, direction=IN
      error E_OK: error-code=0
      error E_NOT_OK: error-code=1
    DigitalServiceWriteReadback
      operation WriteReadback: possible-error=[DigitalServiceWriteReadback/E_OK, DigitalServiceWriteReadback/E_NOT_OK]
        arg Level: type=DigitalLevel, direction=IN
        arg Quality: type=SignalQuality, direction=OUT
      error E_OK: error-code=0
      error E_NOT_OK: error-code=1
    AnalogServiceRead
      operation Read: possible-error=[AnalogServiceRead/E_OK, AnalogServiceRead/E_NOT_OK]
        arg Value: type=AnalogValue, direction=OUT
        arg Quality: type=SignalQuality, direction=OUT
      error E_OK: error-code=0
      error E_NOT_OK: error-code=1
    PwmServiceSetDuty
      operation Set: possible-error=[PwmServiceSetDuty/E_OK, PwmServiceSetDuty/E_NOT_OK]
        arg DutyValue: type=DutyCycle, direction=IN
        arg Quality: type=SignalQuality, direction=OUT
      error E_OK: error-code=0
      error E_NOT_OK: error-code=1
    PwmServiceSetDutyFreq
      operation Set: possible-error=[PwmServiceSetDutyFreq/E_OK, PwmServiceSetDutyFreq/E_NOT_OK]
        arg DutyValue: type=DutyCycle, direction=IN
        arg FrequencyValue: type=Frequency, direction=IN
        arg Quality: type=SignalQuality, direction=OUT
      error E_OK: error-code=0
      error E_NOT_OK: error-code=1
