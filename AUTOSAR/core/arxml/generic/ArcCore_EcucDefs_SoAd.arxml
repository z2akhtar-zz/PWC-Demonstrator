AUTOSAR XML (schema 4-0-3)
package /ArcCore/EcucDefs/Generic
  module definition SoAd [0..1]: refined-module-def=SoAd, variants link-time/post-build/pre-compile  # Configuration of the SoAd (Socket Adaptor) module.
    container SoAdDemEventParameterRefs [0..1]  # Container for the references to DemEventParameter elements which shall be invoked using the API Dem_ReportErrorStatus API in case the corresponding error occurs. The EventId is taken from the referenced DemEventParameter's DemEventId value. The standardized errors are provided in the container and can be extended by vendor specific error references.
      symbolic name reference SOAD_E_INTR [0..1]: set at pre-compile, destination=DemEventParameter  # Reference to the DemEventParameter which shall be issued when the error "Interrupted system call" has occured.
      symbolic name reference SOAD_E_IO [0..1]: set at pre-compile, destination=DemEventParameter  # Reference to the DemEventParameter which shall be issued when the error "Input/output error" has occured.
      symbolic name reference SOAD_E_UPPERBUFF [0..1]: set at pre-compile, destination=DemEventParameter  # Reference to the DemEventParameter which shall be issued when the error "No buffer available in upper layer" has occured.
    container SoAdDoIpConfig: multiple-configuration-container=true  # This container contains all global configuration parameters of the DoIP plug-in.
      float SoAdDoIpAliveCheckResponseTime: 0..4294967.295, set at pre-compile  # This parameter specifies the maximum time that a DoIP entity shall wait for an Alive Check Response after sending an Alive Check Request.
      float SoAdDoIpControlTimeout: 0..Inf, set at pre-compile  # This parameter specifies the maximum time that the test equipment waits for a response to a previously sent control command.
      float SoAdDoIpGenericInactiveTime: 0..4294967.295, set at pre-compile  # This parameter specifies the maximum time of inactivity on a TCP_DATA socket before it is closed.
      string SoAdDoIpHostNameOpt: set at post-build in variant post-build / pre-compile in variant link-time+pre-compile  # Defines the <manufacturer specific> part of the "host name option". | Note: WD ISO 13400 implicitly shows 3 parts to the Host Name Option: 1) It is required to start with "DoIP_" 2) There may be a static OEM specific part 3) There may be a dynamic vehicle specific part, e.g. VIN SoAdDoIpHostNameOpt contains parts 1) and 2) only.
      float SoAdDoIpInitialInactiveTime: 0..4294967.295, set at pre-compile  # This parameter specifies the maximum time of inactivity directly after a TCP_DATA socket was established. After the specified time without Routing Activation, the TCP_DATA socket is closed.
      float SoAdDoIpResponseTimeout: 0..Inf, set at pre-compile  # This parameter specifies the maximum time after which a DoIP information request must have been processed and the corresponding response must have been sent by the DoIP entity, otherwise the request or the response must be considered lost.
      float SoAdDoIpVidAnnounceInterval: 0..4294967.295, set at pre-compile  # This timing parameter specifies the time between the Vehicle Announcement Messages that are sent by DoIP entities after a valid IP address was configured.
      float SoAdDoIpVidAnnounceMaxWait: 0..4294967.295, set at pre-compile  # Describes the maximum time a DoIP entity shall wait before sending an Vehicle Identification Response.
      float SoAdDoIpVidAnnounceMinWait: 0..Inf, set at pre-compile  # Describes the minimum time a DoIP entity shall wait before sending an Vehicle Identification Response.
      integer SoAdDoIpVidAnnounceNum: 0..255, set at pre-compile  # Specifies the number of Vehicle Announcement messages, which the DoIP entity sends after a valid IP address has been configured.
      float ArcDoIpMainFunctionPeriod: 0..4294967.295, origin=ARCCORE_ECUC  # This parameter defines the cycle time of the function DoIp_MainFunction in seconds
      enumeration ArcDoIpNodeType: {SOAD_DOIP_NODETYPE_GATEWAY, SOAD_DOIP_NODETYPE_NODE}, origin=ARCCORE_ECUC, default-value=SOAD_DOIP_NODETYPE_GATEWAY  # This parameter determines what type of DoIp node this is.
      integer ArcDoIpMaxActiveTesterConnections: 0..255, origin=ARCCORE_ECUC  # The maximum number of active tester connections.
      integer ArcDoIpLogicalAddress: 0..65535, origin=ARCCORE_ECUC  # This parameter determines the logical address of the DoIp, i.e. the SA that will route diagnostic requests to the Dcm of the DoIp entity.
      reference ArcSocketAnnouncementRef: origin=ARCCORE_ECUC, destination=SoAdSocketConnection  # Reference to the socket connection used for announcements (Tx only).
      container SoAdDoIpEid  # A unique 6-byte DoIp Entity Identification (EID)
        container SoAdDoIpEidByte [6..6]  # One byte of the DoIp Entity Identification (EID).
          integer SoAdDoIpEidByteIndex: 0..5, set at link in variant link-time / post-build in variant post-build / pre-compile in variant pre-compile  # Index of the Eid byte array.
          integer SoAdDoIpEidByteValue: 0..255, set at link in variant link-time / post-build in variant post-build / pre-compile in variant pre-compile  # Byte Value at the SoAdDoIpEidByteIndex position in the Eid byte array.
    container SoAdDoIpRoute  # A SoAd_DoIP_Route allocates a PDU ID to a combination of a DoIP source and a DoIP target address.
      integer SoAdDoIpSourceAddress: 0..65535, set at link in variant link-time+post-build / pre-compile in variant pre-compile  # The logical DoIP address of the source entitiy.
      integer SoAdDoIpTargetAddress: 0..65535, set at link in variant link-time+post-build / pre-compile in variant pre-compile  # The logical DoIP address of the target entity.
      reference SoAdDoIpSocketConnectionRef: set at link in variant link-time+post-build / pre-compile in variant pre-compile, destination=SoAdSocketConnection  # Reference to the used socket connection.
    container SoAdGeneral  # This container contains all global configuration parameters of SoAd configured from the Pdu Router Module perspective.
      integer SoAdBufferMemorySize: 0..65535, set at pre-compile  # Memory size reserved for SoAd buffers.
      boolean SoAdCallbackApi: set at pre-compile  # True if the TCP/IP stack supports the AUTOSAR Call-back API in addition to the Berkeley Socket API. | TRUE: TCP/IP Stack supports AUTOSAR callback API FALSE: TCP/IP Stack supports only BSD Sockets.
      boolean SoAdDevErrorDetect: set at pre-compile  # Pre-processor switch for enabling development error detection support.
      boolean SoAdDoIpActive: set at pre-compile  # True if a DoIP protocol plug-in is available.
      boolean SoAdDoIpVersionInfoApi: set at pre-compile  # Switches the DoIP_GetVersionInfo() API ON or OFF.
      boolean SoAdIPv6AddressEnabled: set at pre-compile  # Allows for increased memory allocation to store IPv6 addresses. | TRUE: Enables support for IPv6 addresses FALSE: Only IPv4 addresses are supported
      float SoAdMainFunctionPeriod: 0..4294967.295, set at pre-compile  # Determines the frequency at which the SoAd_MainFunction() is called in [s].
      integer SoAdMaxOpenSockets: 0..65535, set at pre-compile  # Specifies the number of sockets that will be open at any one time.
      float SoAdPollingInterval: 0..4294967.295, set at pre-compile  # Specifies the interval at which the SoAd shall poll the TCP/IP stack for new information in [s].
      integer SoAdSocketCount: 1..255, set at pre-compile  # Number of entries in the Socket connection table.
      float SoAdTcpIpMainFunctionPeriod: 0..4294967.295, set at pre-compile  # Determines the frequency at which the TcpIp_MainFunctionCyclic() is called in [s].
      boolean SoAdTcpIpVersionInfoApi: set at pre-compile  # Activates the TCPIP_GetVersionInfo API. | TRUE: Enables the TCPIP_GetVersionInfo API. FALSE: TCPIP_GetVersionInfo API is not included.
      boolean SoAdUdpNmApiEnabled: set at link in variant link-time+post-build / pre-compile in variant pre-compile  # Activates the configurable interfaces to be used by UdpNm. | TRUE: Enables support for the UdpNm API. FALSE: UdpNm API is not included.
      boolean SoAdVersionInfoApi: set at pre-compile  # Activates the SoAd_GetVersionInfo() API. | TRUE: Enables the SoAd_GetVersionInfo() API. FALSE: SoAd_GetVersionInfo() API is not included.
      boolean SoAdXcpApiEnabled: set at link in variant link-time+post-build / pre-compile in variant pre-compile  # Activates the configurable interfaces to be used by Xcp. | TRUE: Enables support for the Xcp API. FALSE: Xcp API is not included.
      function name ArcDoIpPowerModeCallbackFunction [0..1]: origin=ARCCORE_ECUC
    container SoAdPduRoute [1..*]  # Describes the path of a PDU from the PDU Router to the socket in the TCP/IP stack for transmission.
      integer SoAdDestinationId: 0..4294967296, set at link in variant link-time+post-build / pre-compile in variant pre-compile  # ID to be sent on the TCP/IP connection if the PDU header option is enabled.
      integer SoAdSourcePduId: 0..65535, set at link in variant link-time+post-build / pre-compile in variant pre-compile, symbolic-name-value=true  # PDU ID of the PDU coming from the PDU Router.
      integer SoAdSourceSduLength: 0..65535, set at link in variant link-time+post-build / pre-compile in variant pre-compile  # Length in bytes of the SDU to be sent over the TCP/IP stack.
      function name SoAdTxConfirmationUL [0..1]: set at link in variant link-time+post-build / pre-compile in variant pre-compile  # This optional parameter defines the name of the <User_TxConfirmation> in case that SoAdUserTxConfirmationUL is configured to Cdd. If SoAdUserTxConfirmationUL equals PduR, Xcp or UdpNm, the name of the <User_TxConfirmation> is fixed and this parameter is skipped. If SoAdUserTxConfirmationUL equals Cdd, the name of the <User_TxConfirmation> is selectable.
      enumeration SoAdUserTxConfirmationUL: {Cdd, PduR, UdpNm, Xcp}, set at link in variant link-time+post-build / pre-compile in variant pre-compile  # This parameter defines the upper layer (UL) module to which the confirmation of the successfully transmitted SoAdSourcePduId has to be routed via the <User_SoAdTxConfirmation>. | This <User_SoAdTxConfirmation> has to be invoked when the confirmation of the configured SoAdSourcePduId will be received by a Tx confirmation event from the EthIf module.
      reference SoAdDestinationSocketRef: set at link in variant link-time+post-build / pre-compile in variant pre-compile, destination=SoAdSocketConnection  # Connection on which the PDU is to be sent on, references the appropriate entry in the Socket Connection Table.
      reference SoAdSourcePduRef: set at link in variant link-time+post-build / pre-compile in variant pre-compile, destination=Pdu  # Reference to the global PDU structure
    container SoAdSocketConnection [1..*]  # Information required to receive and transmit data via the TCP/IP stack on a particular connection.
      enumeration SoAdAutosarConnector: {Cdd, DoIP, PduR, Xcp}, set at link in variant link-time+post-build / pre-compile in variant pre-compile  # Connection point within the AUTOSAR stack for this socket connection | Availability of protocol plug-ins. Entries in the Socket and PDU Routing Tables.
      boolean SoAdPduHeaderEnable: set at link in variant link-time+post-build / pre-compile in variant pre-compile  # Enables the transmission of the PDU header (ID, length) on this TCP/IP connection. | TRUE: Send PDU header before data FALSE: Send data only
      boolean SoAdPduProvideBufferEnable: set at link in variant link-time+post-build / pre-compile in variant pre-compile  # Enables the use of TP style API towards the PDU Router for this PDU. Will trigger the calls to ProvideRxBuffer and ProvideTxBuffer respectively. | TRUE: The TP stype API is to be used towards the PDU Router. FALSE: The IF style API is to be used towards the PDU Router.
      boolean SoAdResourceManagementEnable: set at link in variant link-time+post-build / pre-compile in variant pre-compile  # Enables the resource management option for this socket. | May not be activated for UDP sockets in receive and not for DoIP sockets. TRUE: resource management option enabled FALSE: resource management option disabled
      boolean SoAdSocketAutosarApi: set at link in variant link-time+post-build / pre-compile in variant pre-compile  # Enables the use of the AUTOSAR call-back API for this connection. | TRUE: Use AUTOSAR call-back API FALSE: Use BSD Socket API Availability of the AUTOSAR Call-back API in the TCP/IP stack.
      integer SoAdSocketId: 0..65535, set at link in variant link-time+post-build / pre-compile in variant pre-compile, symbolic-name-value=true  # The Socket ID is used as a reference to a particular connection when transferring data to and from the PDU Router.
      string SoAdSocketLocalIpAddress: set at link in variant link-time+post-build / pre-compile in variant pre-compile  # Local IP address used for this connection. | Network configuration. Local and Remote Address need to be in the same subnet.
      integer SoAdSocketLocalPort [0..1]: 0..65535, set at link in variant link-time+post-build / pre-compile in variant pre-compile  # Local UDP or TCP port used for this connection.
      enumeration SoAdSocketProtocol: {TCP, UDP}, set at pre-compile  # Specifies the transport protocol (UDP or TCP).
      string SoAdSocketRemoteIpAddress: set at link in variant link-time+post-build / pre-compile in variant pre-compile  # IP address where NM packets are being sent to.
      integer SoAdSocketRemotePort [0..1]: 0..65535, set at link in variant link-time+post-build / pre-compile in variant pre-compile  # Remote UDP or TCP port used for this connection.
      boolean SoAdSocketTcpInitiate [0..1]: set at link in variant link-time+post-build / pre-compile in variant pre-compile  # Specifies the initiator for this TCP connection. | This parameter is only relevant for TCP connections. It will not be defined for UDP sockets. TRUE: This TCP connection is initiated by this module. FALSE: This TCP connection is to be initiated in the listen mode.
      boolean SoAdSocketTcpNoDelay [0..1]: set at link in variant link-time+post-build / pre-compile in variant pre-compile  # Specifies not to use the congestion control mechanism for this connection. This parameter is only relevant for TCP connections. It will not be defined for UDP sockets. | TRUE: This TCP connection will NOT use congestion control. FALSE: This TCP connection will use congestion control.
      boolean SoAdSocketUdpListenOnly [0..1]: set at link in variant link-time+post-build / pre-compile in variant pre-compile  # Used to disable the transmit functionality on this UDP port. This parameter is only relevant for UDP connections. | TRUE: This UDP port cannot transmit data FALSE: This UDP port can send and receive data
      container SoAdDemEventConnectionParameterRefs [0..1]  # Container for the references to DemEventParameter elements which shall be invoked using the API Dem_ReportErrorStatus API in case the corresponding error occurs. The EventId is taken from the referenced DemEventParameter's DemEventId value. The standardized errors are provided in the container and can be extended by vendor specific error references.
        symbolic name reference SOAD_E_AGAIN [0..1]: set at pre-compile, destination=DemEventParameter  # Reference to the DemEventParameter which shall be issued when the error "Resource temporarily unavailable" has occured.
        symbolic name reference SOAD_E_CONNABORTED [0..1]: set at pre-compile, destination=DemEventParameter  # Reference to the DemEventParameter which shall be issued when the error "Software caused connection abort" has occured.
        symbolic name reference SOAD_E_CONNREFUSED [0..1]: set at pre-compile, destination=DemEventParameter  # Reference to the DemEventParameter which shall be issued when the error "Connection refused" has occured.
        symbolic name reference SOAD_E_CONNRESET [0..1]: set at pre-compile, destination=DemEventParameter  # Reference to the DemEventParameter which shall be issued when the error "Connection reset by peer" has occured.
        symbolic name reference SOAD_E_HOSTDOWN [0..1]: set at pre-compile, destination=DemEventParameter  # Reference to the DemEventParameter which shall be issued when the error "Host is down" has occured.
        symbolic name reference SOAD_E_HOSTUNREACH [0..1]: set at pre-compile, destination=DemEventParameter  # Reference to the DemEventParameter which shall be issued when the error "Host is down" has occured.
        symbolic name reference SOAD_E_NETDOWN [0..1]: set at pre-compile, destination=DemEventParameter  # Reference to the DemEventParameter which shall be issued when the error "Network is down" has occured.
        symbolic name reference SOAD_E_NETRESET [0..1]: set at pre-compile, destination=DemEventParameter  # Reference to the DemEventParameter which shall be issued when the error "Network dropped connection on reset" has occured.
        symbolic name reference SOAD_E_NETUNREACH [0..1]: set at pre-compile, destination=DemEventParameter  # Reference to the DemEventParameter which shall be issued when the error "Network is unreachable" has occured.
        symbolic name reference SOAD_E_NOTCONN [0..1]: set at pre-compile, destination=DemEventParameter  # Reference to the DemEventParameter which shall be issued when the error "Socket is not connected" has occured.
        symbolic name reference SOAD_E_PIPE [0..1]: set at pre-compile, destination=DemEventParameter  # Reference to the DemEventParameter which shall be issued when the error "Broken pipe" has occured.
        symbolic name reference SOAD_E_SDULENGTH [0..1]: set at pre-compile, destination=DemEventParameter  # Reference to the DemEventParameter which shall be issued when the error "SDU length mismatch" has occured.
        symbolic name reference SOAD_E_TIMEDOUT [0..1]: set at pre-compile, destination=DemEventParameter  # Reference to the DemEventParameter which shall be issued when the error "Operation timed out" has occured.
    container SoAdSocketRoute [1..*]  # Describes the path of a PDU from a socket in the TCP/IP stack to the PDU Router after reception in the TCP/IP Stack.
      integer SoAdDestinationSduLength: 0..65535, set at link in variant link-time+post-build / pre-compile in variant pre-compile  # Length in bytes of the data contained in the PDU.
      function name SoAdRxIndicationUL [0..1]: set at link in variant link-time+post-build / pre-compile in variant pre-compile  # This parameter defines the name of the <User_RxIndication> in case that SoAdUserRxIndicationUL is configured to Cdd. If SoAdUserRxIndicationUL equals PduR, Xcp or UdpNm, the name of the <User_RxIndication> is fixed and this parameter is skipped. If SoAdUserRxIndicationUL equals CDD the name of the <User_RxIndication> is selectable.
      integer SoAdSourceId: 0..4294967296, set at link in variant link-time+post-build / pre-compile in variant pre-compile  # ID contained in the packet received on the TCP/IP connection if the PDU header option is enabled.
      enumeration SoAdUserRxIndicationUL: {Cdd, PduR, UdpNm, Xcp}, set at link in variant link-time+post-build / pre-compile in variant pre-compile  # This parameter defines the upper layer (UL) module to which the indication of the successfully received SoAd PDU has to be routed via <User_SoAdRxIndication>. This <User_SoAdRxIndication> has to be invoked when the RX indication is received by the EthIf module.
      reference SoAdDestinationPduRef: set at link in variant link-time+post-build / pre-compile in variant pre-compile, destination=Pdu  # Reference to the global PDU structure
      reference SoAdSourceSocketRef: set at link in variant link-time+post-build / pre-compile in variant pre-compile, destination=SoAdSocketConnection  # Connection on which the PDU was received. This references an entry in the Socket Connection Table.
    container ArcDoIpTester [1..65535]
      integer ArcDoIpTesterSA: 0..65535, origin=ARCCORE_ECUC  # This parameter determines the source address of the tester sent via routing activation or diagnostic message.
      reference ArcDoIpRoutingActivationRef [1..255]: origin=ARCCORE_ECUC, destination=ArcDoIpRoutingActivation
    container ArcDoIpTargetAddress [1..65535]
      integer ArcDoIpTargetAddressValue: 1..65535, origin=ARCCORE_ECUC  # Determines the address of a DoIp target address.
      reference ArcDoIpPduRRxPduRef: origin=ARCCORE_ECUC, destination=Pdu  # Determines the RxPdu to connect with the RxPdu of PduR
      reference ArcDoIpPduRTxPduRef: origin=ARCCORE_ECUC, destination=Pdu  # Determines the TxPdu to connect with the TxPdu of PduR
    container ArcDoIpRoutingActivation [1..65535]
      integer ArcDoIpRoutingActivationNumber: 0..255, origin=ARCCORE_ECUC  # This parameter identifies the Routing Activation Number which is received for a DoIp routing activation request message.
      reference ArcDoIpTargetAddressRef [1..255]: origin=ARCCORE_ECUC, destination=ArcDoIpTargetAddress
package /ArcCore/EcucDefs/Generic/Implementations
  bsw implementation SoAd: programming-language=C, sw-version=1.0.0, used-code-generator=generators::generic::SoAd::main, vendor-id=60, ar-release-version=4.0.3, vendor-specific-module-def=SoAd
