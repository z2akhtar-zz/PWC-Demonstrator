AUTOSAR XML (schema 4-1-1)
package /AUTOSAR/Services/Dcm
  impl type Dcm_OpStatusType: compu {0=DCM_INITIAL, 1=DCM_PENDING, 2=DCM_CANCEL, 3=DCM_FORCE_RCRRP_OK}, implementation-data-type=uint8
  impl type Dcm_NegativeResponseCodeType:
    compu {0=DCM_E_POSITIVERESPONSE, 16=DCM_E_GENERALREJECT, 17=DCM_E_SERVICENOTSUPPORTED, 18=DCM_E_SUBFUNCTIONNOTSUPPORTED, 19=DCM_E_INCORRECTMESSAGELENGTHORINVALIDFORMAT, 20=DCM_E_RESPONSETOOLONG, 33=DCM_E_BUSYREPEATREQUEST, 34=DCM_E_CONDITIONSNOTCORRECT, 36=DCM_E_REQUESTSEQUENCEERROR, 37=DCM_E_NORESPONSEFROMSUBNETCOMPONENT, 38=DCM_E_FAILUREPREVENTSEXECUTIONOFREQUESTEDACTION, 49=DCM_E_REQUESTOUTOFRANGE, 51=DCM_E_SECURITYACCESSDENIED, 53=DCM_E_INVALIDKEY, 54=DCM_E_EXCEEDNUMBEROFATTEMPTS, 55=DCM_E_REQUIREDTIMEDELAYNOTEXPIRED, 112=DCM_E_UPLOADDOWNLOADNOTACCEPTED, 113=DCM_E_TRANSFERDATASUSPENDED, 114=DCM_E_GENERALPROGRAMMINGFAILURE, 115=DCM_E_WRONGBLOCKSEQUENCECOUNTER, 126=DCM_E_SUBFUNCTIONNOTSUPPORTEDINACTIVESESSION, 127=DCM_E_SERVICENOTSUPPORTEDINACTIVESESSION, 129=DCM_E_RPMTOOHIGH, 130=DCM_E_RPMTOOLOW, 131=DCM_E_ENGINEISRUNNING, 132=DCM_E_ENGINEISNOTRUNNING, 133=DCM_E_ENGINERUNTIMETOOLOW, 134=DCM_E_TEMPERATURETOOHIGH, 135=DCM_E_TEMPERATURETOOLOW, 136=DCM_E_VEHICLESPEEDTOOHIGH, 137=DCM_E_VEHICLESPEEDTOOLOW, 138=DCM_E_THROTTLE_PEDALTOOHIGH, 139=DCM_E_THROTTLE_PEDALTOOLOW, 140=DCM_E_TRANSMISSIONRANGENOTINNEUTRAL, 141=DCM_E_TRANSMISSIONRANGENOTINGEAR, 143=DCM_E_BRAKESWITCH_NOTCLOSED, 144=DCM_E_SHIFTERLEVERNOTINPARK, 145=DCM_E_TORQUECONVERTERCLUTCHLOCKED, 146=DCM_E_VOLTAGETOOHIGH, 147=DCM_E_VOLTAGETOOLOW}
    range phys 0..255, raw 0..255
    implementation-data-type=uint8
  impl type Dcm_ConfirmationStatusType: compu {0=DCM_RES_POS_OK, 1=DCM_RES_POS_NOT_OK, 2=DCM_RES_NEG_OK, 3=DCM_RES_NEG_NOT_OK}, range phys 0..255, raw 0..255, implementation-data-type=uint8
  impl type Dcm_ProtocolType: compu {0=DCM_OBD_ON_CAN, 1=DCM_OBD_ON_FLEXRAY, 2=DCM_OBD_ON_IP, 3=DCM_UDS_ON_CAN, 4=DCM_UDS_ON_FLEXRAY, 5=DCM_UDS_ON_IP, 6=DCM_ROE_ON_CAN, 7=DCM_ROE_ON_FLEXRAY, 8=DCM_ROE_ON_IP, 9=DCM_PERIODICTRANS_ON_CAN, 10=DCM_PERIODICTRANS_ON_FLEXRAY, 11=DCM_PERIODICTRANS_ON_IP, 12=DCM_NO_ACTIVE_PROTOCOL, 240..254=DCM_SUPPLIER_1..DCM_SUPPLIER_15}, range phys 0..255, raw 0..255, implementation-data-type=uint8
  impl type Dcm_RoeStateType: compu {0=DCM_ROE_ACTIVE, 1=DCM_ROE_UNACTIVE}, range phys 0..255, raw 0..255, implementation-data-type=uint8
  impl type Dcm_SecLevelType: compu {0=DCM_SEC_LEV_LOCKED, 1=DCM_SEC_LEV_L1, 255=DCM_SEC_LEV_ALL}, range phys 0..255, raw 0..255, implementation-data-type=uint8
  impl type Dcm_SesCtrlType: compu {1=DCM_DEFAULT_SESSION, 2=DCM_PROGRAMMING_SESSION, 3=DCM_EXTENDED_DIAGNOSTIC_SESSION, 4=DCM_SAFETY_SYSTEM_DIAGNOSTIC_SESSION, 255=DCM_ALL_SESSION}, range phys 0..255, raw 0..255, implementation-data-type=uint8
  4 x mode declaration group:
    DcmEcuReset: initial-mode=NONE
      7 x mode:
        NONE
        HARD
        KEYONOFF
        SOFT
        JUMPTOBOOTLOADER
        JUMPTOSYSSUPPLIERBOOTLOADER
        EXECUTE
    DcmModeRapidPowerShutDown: initial-mode=ENABLE_RAPIDPOWERSHUTDOWN
      mode ENABLE_RAPIDPOWERSHUTDOWN
      mode DISABLE_RAPIDPOWERSHUTDOWN
    DcmCommunicationControl: initial-mode=DCM_ENABLE_RX_TX_NORM
      12 x mode:
        DCM_ENABLE_RX_TX_NORM
        DCM_ENABLE_RX_DISABLE_TX_NORM
        DCM_DISABLE_RX_ENABLE_TX_NORM
        DCM_DISABLE_RX_TX_NORMAL
        DCM_ENABLE_RX_TX_NM
        DCM_ENABLE_RX_DISABLE_TX_NM
        DCM_DISABLE_RX_ENABLE_TX_NM
        DCM_DISABLE_RX_TX_NM
        DCM_ENABLE_RX_TX_NORM_NM
        DCM_ENABLE_RX_DISABLE_TX_NORM_NM
        DCM_DISABLE_RX_ENABLE_TX_NORM_NM
        DCM_DISABLE_RX_TX_NORM_NM
    DcmControlDTCSetting: initial-mode=ENABLEDTCSETTING
      mode ENABLEDTCSETTING
      mode DISABLEDTCSETTING
  client server interface CallbackDCMRequestServices: is-service=true
    operation StartProtocol: possible-error=[CallbackDCMRequestServices/E_OK, CallbackDCMRequestServices/E_NOT_OK, E_PROTOCOL_NOT_ALLOWED]
      arg ProtocolID: type=Dcm_ProtocolType, direction=IN
    operation StopProtocol: possible-error=[CallbackDCMRequestServices/E_OK, CallbackDCMRequestServices/E_NOT_OK]
      arg ProtocolID: type=Dcm_ProtocolType, direction=IN
    error E_OK: error-code=0
    error E_NOT_OK: error-code=1
    error E_PROTOCOL_NOT_ALLOWED: error-code=5
package /AUTOSAR/Services/Dem
  impl type Dem_EventStatusType: compu {0=DEM_EVENT_STATUS_PASSED, 1=DEM_EVENT_STATUS_FAILED, 2=DEM_EVENT_STATUS_PREPASSED, 3=DEM_EVENT_STATUS_PREFAILED}, range phys 0..3, raw 0..3, implementation-data-type=uint8
  impl type Dem_EventStatusExtendedType: compu {1=DEM_TEST_FAILED, 2=DEM_TEST_FAILED_THIS_OPERATION_CYCLE, 4=DEM_PENDING_DTC, 8=DEM_CONFIRMED_DTC, 16=DEM_TEST_NOT_COMPLETED_SINCE_LAST_CLEAR, 32=DEM_TEST_FAILED_SINCE_LAST_CLEAR, 64=DEM_TEST_NOT_COMPLETED_THIS_OPERATION_CYCLE, 128=DEM_WARNING_INDICATOR_REQUESTED}, range phys 0..255, raw 0..255, implementation-data-type=uint8
  impl type Dem_DTCFormatType: compu {0=DEM_DTC_FORMAT_OBD, 1=DEM_DTC_FORMAT_UDS}, range phys 0..1, raw 0..1, implementation-data-type=uint8
  impl type Dem_OperationCycleStateType: compu {0=DEM_CYCLE_STATE_START, 1=DEM_CYCLE_STATE_END}, range phys 0..1, raw 0..1, implementation-data-type=uint8
  impl type Dem_DTCOriginType: compu {1=DEM_DTC_ORIGIN_PRIMARY_MEMORY, 2=DEM_DTC_ORIGIN_MIRROR_MEMORY, 3=DEM_DTC_ORIGIN_PERMANENT_MEMORY, 4=DEM_DTC_ORIGIN_SECONDARY_MEMORY}, implementation-data-type=uint8
  impl type Dem_ReturnClearDTCType: compu {0=DEM_CLEAR_OK, 1=DEM_CLEAR_WRONG_DTC, 2=DEM_CLEAR_WRONG_DTCORIGIN, 3=DEM_CLEAR_FAILED, 4=DEM_CLEAR_PENDING}, implementation-data-type=uint8
  impl type Dem_IndicatorStatusType: compu {0=DEM_INDICATOR_OFF, 1=DEM_INDICATOR_CONTINUOUS, 2=DEM_INDICATOR_BLINKING, 3=DEM_INDICATOR_BLINK_CONT}, range phys 0..3, raw 0..3, implementation-data-type=uint8
  impl type Dem_InitMonitorReasonType: compu {1=DEM_INIT_MONITOR_CLEAR, 2=DEM_INIT_MONITOR_RESTART}, range phys 1..2, raw 1..2, implementation-data-type=uint8
  4 x impl type:
    Dem_EventIdType: implementation-data-type=uint16
    Dem_OperationCycleIdType: implementation-data-type=uint8
    Dem_DTCStatusMaskType: implementation-data-type=uint8
    Dem_MaxDataValueType: category=ARRAY
      element Dem_MaxDataValueType_elementsImpl: array-size=1, array-size-semantics=FIXED-SIZE, implementation-data-type=uint8
  12 x client server interface, all with is-service=true:
    DiagnosticMonitor
      5 x operation, all with possible-error=[DiagnosticMonitor/E_OK, DiagnosticMonitor/E_NOT_OK]:
        SetEventStatus
          arg EventStatus: type=Dem_EventStatusType, direction=IN
        ResetEventStatus
        PrestoreFreezeFrame
        ClearPrestoredFreezeFrame
        SetEventDisabled
      error E_OK: error-code=0
      error E_NOT_OK: error-code=1
    DiagnosticInfo
      7 x operation:
        GetEventStatus: possible-error=[DiagnosticInfo/E_OK, DiagnosticInfo/E_NOT_OK]
          arg EventStatusExtended: type=Dem_EventStatusExtendedType, direction=OUT
        GetEventFailed: possible-error=[DiagnosticInfo/E_OK, DiagnosticInfo/E_NOT_OK]
          arg EventFailed: type=boolean, direction=OUT
        GetEventTested: possible-error=[DiagnosticInfo/E_OK, DiagnosticInfo/E_NOT_OK]
          arg EventTested: type=boolean, direction=OUT
        GetDTCOfEvent: possible-error=[DiagnosticInfo/E_OK, DiagnosticInfo/E_NOT_OK, DiagnosticInfo/E_NO_DTC_AVAILABLE]
          arg DTCFormat: type=Dem_DTCFormatType, direction=IN
          arg DTCOfEvent: type=uint32, direction=OUT
        GetFaultDetectionCounter: possible-error=[DiagnosticInfo/E_OK, DiagnosticInfo/E_NOT_OK]
          arg FaultDetectionCounter: type=sint8, direction=OUT
        GetEventFreezeFrameData: possible-error=[DiagnosticInfo/E_OK, DiagnosticInfo/E_NOT_OK]
          4 x arg:
            RecordNumber: type=uint8, direction=IN
            ReportTotalRecord: type=boolean, direction=IN
            DataId: type=uint16, direction=IN
            DestBuffer: type=Dem_MaxDataValueType, direction=OUT
        GetEventExtendedDataRecord: possible-error=[DiagnosticInfo/E_OK, DiagnosticInfo/E_NOT_OK]
          arg RecordNumber: type=uint8, direction=IN
          arg DestBuffer: type=Dem_MaxDataValueType, direction=OUT
      error E_OK: error-code=0
      error E_NOT_OK: error-code=1
      error E_NO_DTC_AVAILABLE: error-code=2
    GeneralDiagnosticInfo
      7 x operation:
        GetEventStatus: possible-error=[GeneralDiagnosticInfo/E_OK, GeneralDiagnosticInfo/E_NOT_OK]
          arg EventId: type=Dem_EventIdType, direction=IN
          arg EventStatusExtended: type=Dem_EventStatusExtendedType, direction=OUT
        GetEventFailed: possible-error=[GeneralDiagnosticInfo/E_OK, GeneralDiagnosticInfo/E_NOT_OK]
          arg EventId: type=Dem_EventIdType, direction=IN
          arg EventFailed: type=boolean, direction=OUT
        GetEventTested: possible-error=[GeneralDiagnosticInfo/E_OK, GeneralDiagnosticInfo/E_NOT_OK]
          arg EventId: type=Dem_EventIdType, direction=IN
          arg EventTested: type=boolean, direction=OUT
        GetDTCOfEvent: possible-error=[GeneralDiagnosticInfo/E_OK, GeneralDiagnosticInfo/E_NOT_OK, GeneralDiagnosticInfo/E_NO_DTC_AVAILABLE]
          arg EventId: type=Dem_EventIdType, direction=IN
          arg DTCFormat: type=Dem_DTCFormatType, direction=IN
          arg DTCOfEvent: type=uint32, direction=OUT
        GetFaultDetectionCounter: possible-error=[GeneralDiagnosticInfo/E_OK, GeneralDiagnosticInfo/E_NOT_OK]
          arg EventId: type=Dem_EventIdType, direction=IN
          arg FaultDetectionCounter: type=sint8, direction=OUT
        GetEventFreezeFrameData: possible-error=[GeneralDiagnosticInfo/E_OK, GeneralDiagnosticInfo/E_NOT_OK]
          5 x arg:
            EventId: type=Dem_EventIdType, direction=IN
            RecordNumber: type=uint8, direction=IN
            ReportTotalRecord: type=boolean, direction=IN
            DataId: type=uint16, direction=IN
            DestBuffer: type=Dem_MaxDataValueType, direction=OUT
        GetEventExtendedDataRecord: possible-error=[GeneralDiagnosticInfo/E_OK, GeneralDiagnosticInfo/E_NOT_OK]
          arg EventId: type=Dem_EventIdType, direction=IN
          arg RecordNumber: type=uint8, direction=IN
          arg DestBuffer: type=Dem_MaxDataValueType, direction=OUT
      error E_OK: error-code=0
      error E_NOT_OK: error-code=1
      error E_NO_DTC_AVAILABLE: error-code=2
    EnableCondition
      operation SetEnableCondition: possible-error=[EnableCondition/E_OK, EnableCondition/E_NOT_OK]
        arg ConditionFulfilled: type=boolean, direction=IN
      error E_OK: error-code=0
      error E_NOT_OK: error-code=1
    DcmIf
      operation ClearDTC: possible-error=[DEM_CLEAR_OK, DEM_CLEAR_WRONG_DTC, DEM_CLEAR_WRONG_DTCORIGIN, DEM_CLEAR_WRONG_DTCKIND, DEM_CLEAR_FAILED, DEM_CLEAR_PENDING]
        arg DTC: type=uint32, direction=IN
        arg DTCFormat: type=Dem_DTCFormatType, direction=IN
        arg DTCOrigin: type=Dem_DTCOriginType, direction=IN
      6 x error:
        DEM_CLEAR_OK: error-code=0
        DEM_CLEAR_WRONG_DTC: error-code=1
        DEM_CLEAR_WRONG_DTCORIGIN: error-code=2
        DEM_CLEAR_WRONG_DTCKIND: error-code=3
        DEM_CLEAR_FAILED: error-code=4
        DEM_CLEAR_PENDING: error-code=5
    CallbackClearEventAllowed
      operation ClearEventAllowed: possible-error=CallbackClearEventAllowed/E_NOT_OK
        arg Allowed: type=boolean, direction=OUT
      error E_NOT_OK: error-code=1
    CallbackEventDataChanged
      operation EventDataChanged: possible-error=CallbackEventDataChanged/E_NOT_OK
      error E_NOT_OK: error-code=1
    GeneralCallbackEventDataChanged
      operation EventDataChanged: possible-error=GeneralCallbackEventDataChanged/E_NOT_OK
        arg EventId: type=Dem_EventIdType, direction=IN
      error E_NOT_OK: error-code=1
    GeneralCallbackEventStatusChange
      operation EventStatusChanged: possible-error=GeneralCallbackEventStatusChange/E_NOT_OK
        arg EventId: type=Dem_EventIdType, direction=IN
        arg EventStatusOld: type=Dem_EventStatusExtendedType, direction=IN
        arg EventStatusNew: type=Dem_EventStatusExtendedType, direction=IN
      error E_NOT_OK: error-code=1
    CallbackEventStatusChange
      operation EventStatusChanged: possible-error=CallbackEventStatusChange/E_NOT_OK
        arg EventStatusOld: type=Dem_EventStatusExtendedType, direction=IN
        arg EventStatusNew: type=Dem_EventStatusExtendedType, direction=IN
      error E_NOT_OK: error-code=1
    IndicatorStatus
      operation GetIndicatorStatus: possible-error=IndicatorStatus/E_NOT_OK
        arg IndicatorStatus: type=Dem_IndicatorStatusType, direction=OUT
      error E_NOT_OK: error-code=1
    CallbackInitMonitorForEvent
      operation InitMonitorForEvent: possible-error=CallbackInitMonitorForEvent/E_NOT_OK
        arg InitMonitorReason: type=Dem_InitMonitorReasonType, direction=IN
      error E_NOT_OK: error-code=1
package /AUTOSAR/Services/NvM
  impl type NvM_RequestResultType: compu {0=NVM_REQ_OK, 1=NVM_REQ_NOT_OK, 2=NVM_REQ_PENDING, 3=NVM_REQ_INTEGRITY_FAILED, 4=NVM_REQ_BLOCK_SKIPPED, 5=NVM_REQ_NV_INVALIDATED, 6=NVM_REQ_CANCELED, 7=NVM_REQ_REDUNDANCY_FAILED, 8=NVM_REQ_RESTORED_FROM_ROM}, implementation-data-type=uint8
  impl type NvM_BlockIdType: implementation-data-type=uint16
  client server interface NvMService: is-service=true
    9 x operation, all with possible-error=[NvMService/E_OK, NvMService/E_NOT_OK]:
      GetErrorStatus
        arg RequestResultPtr: type=NvM_RequestResultType, direction=OUT
      SetDataIndex
        arg DataIndex: type=uint8, direction=IN
      GetDataIndex
        arg DataIndexPtr: type=uint8, direction=OUT
      SetRamBlockStatus
        arg BlockChanged: type=boolean, direction=IN
      ReadBlock
        arg DstPtr: type=VoidPtr, direction=IN
      WriteBlock
        arg SrcPtr: type=VoidPtr, direction=IN
      RestoreBlockDefaults
        arg DstPtr: type=VoidPtr, direction=IN
      EraseNvBlock
      InvalidateNvBlock
    error E_OK: error-code=0
    error E_NOT_OK: error-code=1
  client server interface NvMAdmin: is-service=true
    operation SetBlockProtection: possible-error=[NvMAdmin/E_OK, NvMAdmin/E_NOT_OK]
      arg ProtectionEnabled: type=boolean, direction=IN
    error E_OK: error-code=0
    error E_NOT_OK: error-code=1
package /AUTOSAR/Services/EcuM
  impl type EcuM_UserType: implementation-data-type=uint8
  impl type EcuM_StateType:
    compu {16=ECUM_STATE_STARTUP, 17=ECUM_STATE_STARTUP_ONE, 18=ECUM_STATE_STARTUP_TWO, 32=ECUM_STATE_WAKEUP, 33=ECUM_STATE_WAKEUP_ONE, 34=ECUM_STATE_WAKEUP_VALIDATION, 35=ECUM_STATE_WAKEUP_REACTION, 36=ECUM_STATE_WAKEUP_TWO, 37=ECUM_STATE_WAKEUP_WAKESLEEP, 38=ECUM_STATE_WAKEUP_TTII, 48=ECUM_STATE_RUN, 50=ECUM_STATE_APP_RUN, 51=ECUM_STATE_APP_POST_RUN, 64=ECUM_STATE_SHUTDOWN, 68=ECUM_STATE_PREP_SHUTDOWN, 73=ECUM_STATE_GO_SLEEP, 77=ECUM_STATE_GO_OFF_ONE, 78=ECUM_STATE_GO_OFF_TWO, 80=ECUM_STATE_SLEEP, 128=ECUM_STATE_OFF, 144=ECUM_STATE_RESET}
    range phys 16..144, raw 16..144
    implementation-data-type=uint8
  impl type EcuM_BootTargetType: compu {0=ECUM_BOOT_TARGET_APP, 1=ECUM_BOOT_TARGET_OEM_BOOTLOADER, 2=ECUM_BOOT_TARGET_SYS_BOOTLOADER}, range phys 0..2, raw 0..2, implementation-data-type=uint8
  mode declaration group EcuM_Mode: initial-mode=STARTUP
    6 x mode:
      STARTUP
      RUN
      POST_RUN
      SLEEP
      WAKE_SLEEP
      SHUTDOWN
  data type mapping set EcuMFixedTypeMappings: mode-request-type-map{implementation-data-type=uint8, mode-group=EcuM_Mode}
  client server interface EcuM_StateRequest: is-service=true
    4 x operation, all with possible-error=[EcuM_StateRequest/E_OK, EcuM_StateRequest/E_NOT_OK]:
      RequestRUN
      ReleaseRUN
      RequestPOSTRUN
      ReleasePOSTRUN
    error E_OK: error-code=0
    error E_NOT_OK: error-code=1
  client server interface EcuM_ShutdownTarget: is-service=true
    operation SelectShutdownTarget: possible-error=[EcuM_ShutdownTarget/E_OK, EcuM_ShutdownTarget/E_NOT_OK]
      arg target: type=EcuM_StateType, direction=IN
      arg mode: type=uint8, direction=IN
    operation GetShutdownTarget: possible-error=[EcuM_ShutdownTarget/E_OK, EcuM_ShutdownTarget/E_NOT_OK]
      arg target: type=EcuM_StateType, direction=OUT
      arg mode: type=uint8, direction=OUT
    operation GetLastShutdownTarget: possible-error=[EcuM_ShutdownTarget/E_OK, EcuM_ShutdownTarget/E_NOT_OK]
      arg target: type=EcuM_StateType, direction=OUT
      arg mode: type=uint8, direction=OUT
    error E_OK: error-code=0
    error E_NOT_OK: error-code=1
  client server interface EcuM_BootTarget: is-service=true
    operation SelectBootTarget: possible-error=[EcuM_BootTarget/E_OK, EcuM_BootTarget/E_NOT_OK]
      arg target: type=EcuM_BootTargetType, direction=IN
    operation GetBootTarget: possible-error=[EcuM_BootTarget/E_OK, EcuM_BootTarget/E_NOT_OK]
      arg target: type=EcuM_BootTargetType, direction=OUT
    error E_OK: error-code=0
    error E_NOT_OK: error-code=1
  mode switch interface EcuM_CurrentMode: is-service=true
    mode group currentMode: type=EcuM_Mode
package /AUTOSAR/Services/Det
  client server interface DETService: is-service=true
    operation ReportError: possible-error=DETService/E_OK
      arg InstanceId: type=uint8, direction=IN
      arg ApiId: type=uint8, direction=IN
      arg ErrorId: type=uint8, direction=IN
    error E_OK: error-code=0
package /AUTOSAR/Services/ComM
  impl type ComM_UserHandleType: compu {255=COMM_NOT_USED_USER_ID}, range phys 0..255, raw 0..255, implementation-data-type=uint8
  impl type ComM_InhibitionStatusType: implementation-data-type=uint8
  impl type ComM_ModeType: compu {0=COMM_NO_COMMUNICATION, 1=COMM_SILENT_COMMUNICATION, 2=COMM_FULL_COMMUNICATION}, range phys 0..2, raw 0..2, implementation-data-type=uint8
  mode declaration group ComMMode: initial-mode=COMM_NO_COMMUNICATION
    mode COMM_NO_COMMUNICATION
    mode COMM_SILENT_COMMUNICATION
    mode COMM_FULL_COMMUNICATION
  data type mapping set ComMTypeMappings: mode-request-type-map{implementation-data-type=uint8, mode-group=ComMMode}
  client server interface ComM_UserRequest: is-service=true
    4 x operation:
      RequestComMode: possible-error=[ComM_UserRequest/E_OK, ComM_UserRequest/E_NOT_OK, E_MODE_LIMITATION]
        arg ComMode: type=ComM_ModeType, direction=IN
      GetCurrentComMode: possible-error=[ComM_UserRequest/E_OK, ComM_UserRequest/E_NOT_OK]
        arg ComMode: type=ComM_ModeType, direction=OUT
      GetMaxComMode: possible-error=[ComM_UserRequest/E_OK, ComM_UserRequest/E_NOT_OK]
        arg ComMode: type=ComM_ModeType, direction=OUT
      GetRequestedComMode: possible-error=[ComM_UserRequest/E_OK, ComM_UserRequest/E_NOT_OK]
        arg ComMode: type=ComM_ModeType, direction=OUT
    error E_OK: error-code=0
    error E_NOT_OK: error-code=1
    error E_MODE_LIMITATION: error-code=2
  mode switch interface ComM_CurrentMode: is-service=true
    mode group currentMode: type=ComMMode
  client server interface ComM_ECUModeLimitation: is-service=true
    4 x operation, all with possible-error=ComM_ECUModeLimitation/E_NOT_OK:
      LimitECUToNoComMode
        arg Status: type=boolean, direction=IN
      ReadInhibitCounter
        arg CounterValue: type=uint16, direction=OUT
      ResetInhibitCounter
      SetECUGroupClassification
        arg Status: type=ComM_InhibitionStatusType, direction=IN
    error E_NOT_OK: error-code=1
  client server interface ComM_ChannelWakeup: is-service=true
    operation PreventWakeUp: possible-error=ComM_ChannelWakeup/E_NOT_OK
      arg Status: type=boolean, direction=IN
    operation GetInhibitionStatus: possible-error=ComM_ChannelWakeup/E_NOT_OK
      arg Status: type=ComM_InhibitionStatusType, direction=OUT
    error E_NOT_OK: error-code=1
  client server interface ComM_ChannelLimitation
    operation LimitChannelToNoComMode: possible-error=ComM_ChannelLimitation/E_NOT_OK
      arg Status: type=boolean, direction=IN
    operation GetInhibitionStatus: possible-error=ComM_ChannelLimitation/E_NOT_OK
      arg Status: type=ComM_InhibitionStatusType, direction=OUT
    error E_NOT_OK: error-code=1
