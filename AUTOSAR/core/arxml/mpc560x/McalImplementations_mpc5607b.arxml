AUTOSAR XML (schema 4-1-1)
package /ArcCore/EcucDefs/Implementations/mpc5607b
  10 x bsw implementation, all with programming-language=C, vendor-id=60, ar-release-version=4.1.2:
    Adc: sw-version=2.0.0, used-code-generator=generators::mcal::mpc560x::Adc::main, vendor-specific-module-def=Adc
    Can: sw-version=5.0.0, used-code-generator=generators::mcal::mpc560x::Can::main, vendor-specific-module-def=Can
    Dio: sw-version=5.0.0, used-code-generator=generators::mcal::mpc560x::Dio::main, vendor-specific-module-def=Dio
    Gpt: sw-version=3.0.0, used-code-generator=generators::mcal::mpc560x::Gpt::main, vendor-specific-module-def=Gpt
    Lin: sw-version=2.1.0, used-code-generator=generators::mcal::mpc560x::Lin::main, vendor-specific-module-def=Lin
    Mcu: sw-version=2.0.0, used-code-generator=generators::mcal::mpc560x::Mcu::main, vendor-specific-module-def=Mcu
    Pwm: sw-version=2.0.0, used-code-generator=generators::mcal::mpc560x::Pwm::main, vendor-specific-module-def=Pwm
    Spi: sw-version=2.0.0, used-code-generator=generators::mcal::mpc560x::Spi::main, vendor-specific-module-def=Spi
    Icu: sw-version=2.0.0, used-code-generator=generators::mcal::mpc560x::Icu::main, vendor-specific-module-def=Icu
    Ocu: sw-version=1.0.0, used-code-generator=generators::mcal::mpc560x::Ocu::main, vendor-specific-module-def=Ocu
