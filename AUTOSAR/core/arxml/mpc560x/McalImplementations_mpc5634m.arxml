AUTOSAR XML (schema 4-1-1)
package /ArcCore/Implementations/mpc5634m
  8 x bsw implementation, all with ar-release-version=4.1.2:
    Can: sw-version=5.0.0, used-code-generator=generators::mcal::mpc560x::Can::main, vendor-id=60, vendor-specific-module-def=Can
    Dio: sw-version=5.0.0, used-code-generator=generators::mcal::mpc560x::Dio::main, vendor-id=60, vendor-specific-module-def=Dio
    Gpt: programming-language=C, sw-version=3.0.0, used-code-generator=generators::mcal::mpc560x::Gpt::main, vendor-id=60, vendor-specific-module-def=Gpt
    Mcu: programming-language=C, sw-version=2.0.0, used-code-generator=generators::mcal::mpc560x::Mcu::main, vendor-id=60, vendor-specific-module-def=Mcu
    Spi: programming-language=C, sw-version=2.0.0, used-code-generator=generators::mcal::mpc560x::Spi::main, vendor-id=60, vendor-specific-module-def=Spi
    Adc: programming-language=C, sw-version=2.0.0, used-code-generator=generators::mcal::mpc5567::Adc::main, vendor-specific-module-def=Adc
    Pwm: programming-language=C, sw-version=2.0.0, used-code-generator=generators::mcal::mpc551x::Pwm::main, vendor-specific-module-def=Pwm
    Lin: programming-language=C, sw-version=2.1.0, used-code-generator=generators::mcal::mpc551x::Lin::main, vendor-id=60, vendor-specific-module-def=Lin
