AUTOSAR XML (schema 4-1-1)
package /ArcCore/EcucDefs/mpc560x
  bsw implementation Spi: programming-language=C, sw-version=2.0.0, used-code-generator=generators::mcal::mpc560x::Spi::main, vendor-id=60, ar-release-version=4.1.2, vendor-specific-module-def=Spi
package /ArcCore/EcucDefs/mpc560x/Implementations
  7 x bsw implementation, all with vendor-id=60, ar-release-version=4.1.2:
    Lin: programming-language=C, sw-version=2.1.0, used-code-generator=generators::mcal::mpc560x::Lin::main, vendor-specific-module-def=Lin
    Pwm: programming-language=C, sw-version=2.0.0, used-code-generator=generators::mcal::mpc560x::Pwm::main, vendor-specific-module-def=Pwm
    Mcu: programming-language=C, sw-version=2.0.0, used-code-generator=generators::mcal::mpc560x::Mcu::main, vendor-specific-module-def=Mcu
    Gpt: programming-language=C, sw-version=3.0.0, used-code-generator=generators::mcal::mpc560x::Gpt::main, vendor-specific-module-def=Gpt
    Dio: programming-language=C, sw-version=5.0.0, used-code-generator=generators::mcal::mpc560x::Dio::main, vendor-specific-module-def=Dio
    Can: sw-version=5.0.0, used-code-generator=generators::mcal::mpc560x::Can::main, vendor-specific-module-def=Can
    Adc: programming-language=C, sw-version=2.0.0, used-code-generator=generators::mcal::mpc560x::Adc::main, vendor-specific-module-def=Adc
