AUTOSAR XML (schema 4-1-1)
package /ArcCore/Implementations/mpc5744p
  8 x bsw implementation, all with vendor-id=60, ar-release-version=4.1.2:
    Adc: programming-language=C, sw-version=2.0.0, used-code-generator=generators::mcal::mpc560x::Adc::main, vendor-specific-module-def=Adc
    Can: programming-language=C, sw-version=5.0.0, used-code-generator=generators::mcal::mpc560x::Can::main, vendor-specific-module-def=Can
    Dio: sw-version=5.0.0, used-code-generator=generators::mcal::mpc560x::Dio::main, vendor-specific-module-def=Dio
    Gpt: programming-language=C, sw-version=3.0.0, used-code-generator=generators::mcal::mpc560x::Gpt::main, vendor-specific-module-def=Gpt
    Mcu: programming-language=C, sw-version=2.0.0, used-code-generator=generators::mcal::mpc560x::Mcu::main, vendor-specific-module-def=Mcu
    Pwm: programming-language=C, sw-version=2.0.0, used-code-generator=generators::mcal::mpc560x::PwmFlex::main, vendor-specific-module-def=Pwm
    Spi: programming-language=C, sw-version=2.0.0, used-code-generator=generators::mcal::mpc560x::Spi::main, vendor-specific-module-def=Spi
    Lin: programming-language=C, sw-version=2.1.0, used-code-generator=generators::mcal::mpc560x::Lin::main, vendor-specific-module-def=Lin
