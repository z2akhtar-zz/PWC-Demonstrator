AUTOSAR XML (schema 4-1-1)
package /ArcCore/Implementations/rh850f1h
  5 x bsw implementation, all with programming-language=C, vendor-id=60:
    Can: sw-version=5.0.0, used-code-generator=generators::mcal::rh850::Can::main, ar-release-version=4.1.3, vendor-specific-module-def=Can
    Fr: sw-version=1.0.0, used-code-generator=generators::mcal::rh850::Fr::main, ar-release-version=4.0.3, vendor-specific-module-def=Fr
    Port: sw-version=5.0.0, used-code-generator=generators::mcal::rh850::Port::main, ar-release-version=4.1.2, vendor-specific-module-def=Port
    Dio: sw-version=5.0.0, used-code-generator=generators::mcal::rh850::Dio::main, ar-release-version=4.1.2, vendor-specific-module-def=Dio
    Gpt: sw-version=3.0.0, used-code-generator=generators::mcal::rh850::Gpt::main, ar-release-version=4.1.3, vendor-specific-module-def=Gpt
