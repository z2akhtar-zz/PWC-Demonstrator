AUTOSAR XML (schema 4-0-3)
package /ArcCore/EcucDefs/ST/stm32f10x
  module definition Port [0..1]: refined-module-def=Port, variants pre-compile  # Configuration of the Port module.
    container PortConfigSet: multiple-configuration-container=true  # This container is the base of a multiple configuration set
      enumeration ArcPortPinRemap [0..*]: {GPIO_Remap_TIM10, GPIO_PartialRemap_TIM1, GPIO_Remap_I2C1, GPIO_Remap_SPI1, GPIO_Remap_USART1, GPIO_Remap_USART2, GPIO_FullRemap_USART3, GPIO_FullRemap_TIM1, GPIO_PartialRemap1_TIM2, GPIO_PartialRemap2_TIM2, GPIO_PartialRemap_USART3, GPIO_FullRemap_TIM2, GPIO_PartialRemap_TIM3, GPIO_FullRemap_TIM3, GPIO_Remap_MISC, GPIO_Remap_TIM12, GPIO_Remap_TIM67_DAC_DMA, GPIO_Remap_FSMC_NADV, GPIO_Remap_TIM14, GPIO_Remap_TIM13, GPIO_Remap_TIM11, GPIO_Remap_TIM9, GPIO_Remap_TIM1_DMA, GPIO_Remap_CEC, GPIO_Remap_TIM4, GPIO_Remap1_CAN1, GPIO_Remap2_CAN1, GPIO_Remap_PD01, GPIO_Remap_TIM5CH4_LSI, GPIO_Remap_ADC1_ETRGINJ, GPIO_Remap_ADC1_ETRGREG, GPIO_Remap_ADC2_ETRGINJ, GPIO_Remap_ADC2_ETRGREG, GPIO_Remap_ETH, GPIO_Remap_CAN2, GPIO_Remap_SWJ_NoJTRST, GPIO_Remap_SWJ_JTAGDisable, GPIO_Remap_SWJ_Disable, GPIO_Remap_SPI3, GPIO_Remap_TIM2ITR1_PTP_SOF, GPIO_Remap_PTP_PPS, GPIO_Remap_TIM15, GPIO_Remap_TIM16, GPIO_Remap_TIM17}, set at post-build in variant post-build / pre-compile in variant pre-compile, origin=ARCCORE_ECUC  # Port pin remappings.
      container PortContainer [1..*]  # Container collecting the PortPins.
        integer PortNumberOfPortPins: 1..65535, set at pre-compile  # The number of specified PortPins in this PortContainer.
        container PortPin [1..*]  # Configuration of the individual port pins.
          enumeration PortPinDirection: {PORT_PIN_IN, PORT_PIN_OUT}, set at post-build in variant post-build / pre-compile in variant pre-compile  # The initial direction of the pin (IN or OUT). If the direction is not changeable, the value configured here is fixed. | The direction must match the pin mode. E.g. a pin used for an ADC must be configured to be an in port. Implementation Type: Port_PinDirectionType
          boolean PortPinDirectionChangeable: set at post-build in variant post-build / pre-compile in variant pre-compile  # Parameter to indicate if the direction is changeable on a port pin during runtime. | true: Port Pin direction changeable enabled. false: Port Pin direction changeable disabled.
          integer PortPinId: 1..65535, set at pre-compile, symbolic-name-value=true  # Pin Id of the port pin. This value will be assigned to the symbolic name derived from the port pin container short name.
          enumeration PortPinInitialMode: {PORT_PIN_MODE_ADC, PORT_PIN_MODE_CAN, PORT_PIN_MODE_DIO, PORT_PIN_MODE_DIO_GPT, PORT_PIN_MODE_DIO_WDG, PORT_PIN_MODE_FLEXRAY, PORT_PIN_MODE_ICU, PORT_PIN_MODE_LIN, PORT_PIN_MODE_MEM, PORT_PIN_MODE_PWM, PORT_PIN_MODE_SPI, PORT_PIN_MODE_OTHER, PORT_PIN_MODE_OTHER0, PORT_PIN_MODE_OTHER1, PORT_PIN_MODE_OTHER2, PORT_PIN_MODE_OTHER3}, set at post-build in variant post-build / pre-compile in variant pre-compile  # Port pin mode from mode list for use with Port_Init() function.
          enumeration PortPinLevelValue: {PORT_PIN_LEVEL_HIGH, PORT_PIN_LEVEL_LOW}, set at post-build in variant post-build / pre-compile in variant pre-compile  # Port Pin Level value from Port pin list.
          enumeration PortPinMode [1..*]: {PORT_PIN_MODE_ADC, PORT_PIN_MODE_CAN, PORT_PIN_MODE_DIO, PORT_PIN_MODE_DIO_GPT, PORT_PIN_MODE_DIO_WDG, PORT_PIN_MODE_FLEXRAY, PORT_PIN_MODE_ICU, PORT_PIN_MODE_LIN, PORT_PIN_MODE_MEM, PORT_PIN_MODE_PWM, PORT_PIN_MODE_SPI}, set at post-build in variant post-build / pre-compile in variant pre-compile  # Port pin mode from mode list. | Note that more than one mode is allowed by default. That way it is e.g. possible to combine DIO with another mode such as ICU.
          boolean PortPinModeChangeable: set at post-build in variant post-build / pre-compile in variant pre-compile  # Parameter to indicate if the mode is changeable on a port pin during runtime. True: Port Pin mode changeable allowed. False: Port Pin mode changeable not permitted.
          enumeration ArcPortPinGpioMode: {GPIO_ANALOG_INPUT_CNF, GPIO_FLOATING_INPUT_CNF, GPIO_INPUT_PULLUP_CNF, GPIO_RESERVED_CNF, GPIO_OUTPUT_PUSHPULL_CNF, GPIO_OUTPUT_OPENDRAIN_CNF, GPIO_ALT_PUSHPULL_CNF, GPIO_ALT_OPENDRAIN_CNF}, set at post-build in variant post-build / pre-compile in variant pre-compile, origin=ARCCORE_ECUC  # Sets internal hardware specific GPIO mode attribute for this pin.
          enumeration ArcPortPinSlewRate: {PORT_PIN_SLEW_RATE_MIN, PORT_PIN_SLEW_RATE_MED, PORT_PIN_SLEW_RATE_MAX}, set at post-build in variant post-build / pre-compile in variant pre-compile, origin=ARCCORE_ECUC  # Sets the slew rate for this pin.
    container PortGeneral  # Module wide configuration parameters of the PORT driver.
      boolean PortDevErrorDetect: set at pre-compile, default-value=1  # Switches the Development Error Detection and Notification on or off. | true: Enabled. false: Disabled.
      boolean PortSetPinDirectionApi: set at pre-compile, default-value=0  # Pre-processor switch to enable / disable the use of the function Port_SetPinDirection(). | TRUE: Enabled - Function Port_SetPinDirection() is available. FALSE: Disabled - Function Port_SetPinDirection() is not available.
      boolean PortSetPinModeApi: set at pre-compile, default-value=0  # Pre-processor switch to enable / disable the use of the function Port_SetPinMode(). | true: Enabled - Function Port_SetPinMode() is available. false: Disabled - Function Port_SetPinMode() is not available.
      boolean PortVersionInfoApi: set at pre-compile, default-value=0  # Pre-processor switch to enable / disable the API to read out the modules version information. | true: Version info API enabled. false: Version info API disabled.
