AUTOSAR XML (schema 4-1-1)
package /ArcCore/Implementations/stm32f107
  7 x bsw implementation, all with ar-release-version=4.1.2:
    Dio: sw-version=5.0.0, used-code-generator=generators::mcal::stm32f10x::Dio::main, vendor-id=60, vendor-specific-module-def=Dio
    Port: sw-version=5.0.0, used-code-generator=generators::mcal::stm32f10x::Port::main, vendor-id=60, vendor-specific-module-def=Port
    Adc: programming-language=C, sw-version=2.0.0, used-code-generator=generators::mcal::stm32f10x::Adc::main, vendor-specific-module-def=Adc
    Can: sw-version=5.0.0, used-code-generator=generators::mcal::stm32f10x::Can::main, vendor-id=60, vendor-specific-module-def=Can
    Mcu: programming-language=C, sw-version=2.0.0, used-code-generator=generators::mcal::stm32f10x::Mcu::main, vendor-id=60, vendor-specific-module-def=Mcu
    Pwm: programming-language=C, sw-version=2.0.0, used-code-generator=generators::mcal::stm32f10x::Pwm::main, vendor-specific-module-def=Pwm
    Gpt: programming-language=C, sw-version=3.0.0, used-code-generator=generators::mcal::stm32f10x::Gpt::main, vendor-specific-module-def=Gpt
