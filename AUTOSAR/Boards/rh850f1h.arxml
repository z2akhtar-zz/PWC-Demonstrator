AUTOSAR XML (schema 4-1-1)
package /ArcCore/Boards/rh850f1h
  ecuc value collection rh850f1h: ecuc-values=[Fr, EcuM, Can]
  module config Fr: implementation-config-variant=VARIANT-PRE-COMPILE, module-description=Fr
    FrGeneral:
      FrBufferReconfig = (unset)
      FrCtrlTestCount = 1
      FrDevErrorDetect = (unset)
      FrIndex = (unset)
      FrNumCtrlSupported = (unset)
      FrRxStringentCheck = false
      FrRxStringentLengthCheck = false
      FrVersionInfoApi = (unset)
    FrMultipleConfiguration
      FrController:
        FrCtrlIdx = (unset)
        FrPAllowHaltDueToClock = (unset)
        FrPAllowPassiveToActive = (unset)
        FrPChannels = 
        FrPClusterDriftDamping = (unset)
        FrPDecodingCorrection = (unset)
        FrPDelayCompensationA = (unset)
        FrPDelayCompensationB = (unset)
        FrPExternalSync = (unset)
        FrPFallBackInternal = (unset)
        FrPKeySlotId = (unset)
        FrPKeySlotOnlyEnabled = (unset)
        FrPKeySlotUsedForStartup = (unset)
        FrPKeySlotUsedForSync = (unset)
        FrPLatestTx = (unset)
        FrPMacroInitialOffsetA = (unset)
        FrPMacroInitialOffsetB = (unset)
        FrPMicroInitialOffsetA = (unset)
        FrPMicroInitialOffsetB = (unset)
        FrPMicroPerCycle = (unset)
        FrPNmVectorEarlyUpdate = (unset)
        FrPOffsetCorrectionOut = (unset)
        FrPOffsetCorrectionStart = (unset)
        FrPPayloadLengthDynMax = (unset)
        FrPRateCorrectionOut = (unset)
        FrPSamplesPerMicrotick = 
        FrPSecondKeySlotId = (unset)
        FrPTwoKeySlotMode = (unset)
        FrPWakeupChannel = 
        FrPWakeupPattern = (unset)
        FrPdAcceptedStartupRange = (unset)
        FrPdListenTimeout = (unset)
        FrPdMicrotick = 
        FrAbsoluteTimer: FrAbsTimerIdx=(unset)
  module config EcuM: implementation-config-variant=VARIANT-PRE-COMPILE, module-description=EcuM
    EcuMConfiguration
      EcuMCommonConfiguration: EcuMConfigConsistencyHash=(unset), EcuMDefaultAppMode=(unset), EcuMOSResource=(unset)
        EcuMDefaultShutdownTarget: EcuMDefaultState=EcuMStateOff
        EcuMSleepMode: EcuMSleepModeId=(unset), EcuMSleepModeSuspend=(unset), EcuMSleepModeMcuModeRef=(unset), EcuMWakeupSourceMask=(unset)
        EcuMWakeupSource: EcuMWakeupSourceId=(unset), EcuMWakeupSourcePolling=0, EcuMResetReasonRef=(unset)
      EcuMFixedConfiguration: EcuMNvramReadallTimeout=10.0, EcuMNvramWriteallTimeout=10.0, EcuMRunMinimumDuration=10.0, EcuMNormalMcuModeRef=(unset)
        EcuMFixedUserConfig: EcuMFixedUser=(unset)
    EcuMGeneral: EcuMDevErrorDetect=0, EcuMIncludeDem=0, EcuMIncludeDet=0, EcuMMainFunctionPeriod=0.2, EcuMVersionInfoApi=0
  module config Can: implementation-config-variant=VARIANT-PRE-COMPILE, module-description=Can
    CanConfigSet
      CanController:
        CanBusoffProcessing = INTERRUPT
        CanControllerActivation = 1
        CanControllerBaseAddress = (unset)
        CanControllerId = (unset)
        CanRxProcessing = INTERRUPT
        CanTxProcessing = INTERRUPT
        CanWakeupFunctionalityAPI = false
        CanWakeupProcessing = INTERRUPT
        CanWakeupSupport = 0
        ArcCanControllerLoopback = 0
        CanControllerDefaultBaudrate = (unset)
        CanCpuClockRef = (unset)
        CanControllerBaudrateConfig:
          CanControllerBaudRate = 500
          CanControllerBaudRateConfigID = 0
          CanControllerPropSeg = 7
          CanControllerSeg1 = 4
          CanControllerSeg2 = 4
          CanControllerSyncJumpWidth = 2
      CanHardwareObject: CanHandleType=, CanIdType=, CanObjectId=(unset), CanObjectType=, CanControllerRef=(unset)
    CanGeneral:
      CanDevErrorDetection = 1
      CanHardwareCancellation = 0
      CanIdenticalIdCancellation = 0
      CanIndex = (unset)
      CanMainFunctionModePeriod = (unset)
      CanMultiplexedTransmission = 0
      CanTimeoutDuration = (unset)
      CanVersionInfoApi = 0
      CanCounterRef = (unset)
      CanSupportTTCANRef = (unset)
      CanMainFunctionRWPeriods
