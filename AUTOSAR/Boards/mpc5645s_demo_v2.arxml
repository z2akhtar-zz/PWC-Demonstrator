AUTOSAR XML (schema 4-1-1)
package /ArcCore/Boards/mpc5645s_demo_v2
  ecuc value collection board_mpc5645s_demo_v2: ecuc-values=[Mcu, EcuM]
  module config Mcu: implementation-config-variant=VARIANT-PRE-COMPILE, module-description=Mcu
    McuGeneralConfiguration: McuDevErrorDetect=1, McuGetRamStateApi=1, McuInitClock=1, McuNoPll=0, McuPerformResetApi=1, McuVersionInfoApi=0
    McuModuleConfiguration: McuClockSrcFailureNotification=DISABLED, McuNumberOfMcuModes=(unset), McuRamSectors=(unset), ArcDefaultClockRef=McuClockSettingConfig
      McuClockSettingConfig: McuClockSettingId=(unset)
        PLLSettings124MHzOn8MHzOsc (PLLSettings): IDF=0, NDIV=62, ODF=0
        McuClockReferencePoint: Frequency=(unset), McuClockReferencePointFrequency=8000000.0
      3 x McuModeSettingConf, all with McuMode=(unset):
        SLEEP
        RUN
        NORMAL
    McuPublishedInformation
      McuResetReasonConf: McuResetReason=(unset)
        McuResetReasonConf: McuResetReason=(unset)
  module config EcuM: implementation-config-variant=VARIANT-PRE-COMPILE, module-description=EcuM
    EcuMConfiguration
      EcuMCommonConfiguration: EcuMConfigConsistencyHash=(unset), EcuMDefaultAppMode=(unset), EcuMOSResource=(unset)
        EcuMDefaultShutdownTarget: EcuMDefaultState=EcuMStateOff
        EcuMSleepMode: EcuMSleepModeId=(unset), EcuMSleepModeSuspend=(unset), EcuMSleepModeMcuModeRef=SLEEP, EcuMWakeupSourceMask=EcuMWakeupSource
        EcuMWakeupSource: EcuMWakeupSourceId=(unset), EcuMWakeupSourcePolling=0, EcuMResetReasonRef=(unset)
      EcuMFixedConfiguration: EcuMNvramReadallTimeout=10.0, EcuMNvramWriteallTimeout=10.0, EcuMRunMinimumDuration=10.0, EcuMNormalMcuModeRef=RUN
        EcuMFixedUserConfig: EcuMFixedUser=(unset)
    EcuMGeneral: EcuMDevErrorDetect=0, EcuMIncludeDem=0, EcuMIncludeDet=0, EcuMMainFunctionPeriod=0.2, EcuMVersionInfoApi=0
